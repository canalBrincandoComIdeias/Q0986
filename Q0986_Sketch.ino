/*
*    AUTOR:		  BrincandoComIdeias
*    APRENDA: 	https://cursodearduino.net/
*    SKETCH:    Controle de Umidade do Ar + Display Oled
*    DATA:		  06/02/2023
*/

// INCLUSÃO DE BIBLIOTECAS
#include "DHT.h"
#include <MicroLCD.h>

// DEFINIÇÕES DE PINOS
#define pinDHT 7
#define pinUmid 8
#define pinAr 9

// DEFINIÇÕES
#define UR_MAX 60    // Umidade Relativa Maxima
#define UR_IDEAL 55  // Umidade Alvo
#define UR_MIN 50    // Umidade Relativa Minima

#define INTERVALO_LEITURA 2000  // Intervalo minimo de leitura do DHT22 ~2s

// INSTANCIANDO OBJETOS
DHT dht(pinDHT, DHT22);
LCD_SH1106 lcd;   //LCD_SSD1306   //LCD_SH1106   //LCD_PCD8544

// DECLARAÇÃO DE VARIÁVEIS
float umidade = 55.0;

int estado = 0;  // 0 = Ar ideal | -1 = Umidificador ligado | 1 = Ar condicionado Ligado
unsigned long controleLeitura;

const PROGMEM uint8_t logo[48 * 48 / 8] = {
0x00, 0x00, 0x00, 0x00, 0x00, 0x00, 0x00, 0x00, 0x00, 0x00, 0x00, 0x80, 0xC0, 0xC0, 0xE0, 0xE0,
0xF0, 0xF0, 0xF8, 0xF8, 0xF8, 0xF8, 0xF8, 0x18, 0x18, 0xF8, 0xF8, 0xF8, 0xF8, 0xF8, 0xF0, 0xF0,
0xE0, 0xE0, 0xC0, 0xC0, 0x80, 0x00, 0x00, 0x00, 0x00, 0x00, 0x00, 0x00, 0x00, 0x00, 0x00, 0x00,
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0x07, 0x03, 0x03, 0x01, 0x00, 0x00, 0x00, 0x00, 0x00, 0x00, 0x00, 0x00, 0x00, 0x00, 0x00, 0x00
};

const PROGMEM uint8_t humidity[32 * 32 / 8] = {
0x00, 0x00, 0x00, 0x00, 0x00, 0x00, 0x00, 0x00, 0x00, 0x00, 0x80, 0xC0, 0x60, 0x30, 0x0C, 0x06,
0x06, 0x0C, 0x30, 0x60, 0xC0, 0x80, 0x00, 0x00, 0x00, 0x00, 0x00, 0x00, 0x00, 0x00, 0x00, 0x00,
0x00, 0x00, 0x00, 0x00, 0x00, 0x80, 0xE0, 0x30, 0x1C, 0x06, 0xC3, 0xE0, 0x30, 0x30, 0xE0, 0xC0,
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0x43, 0x47, 0x4C, 0x4C, 0x67, 0x23, 0x30, 0x18, 0x0C, 0x07, 0x01, 0x00, 0x00, 0x00, 0x00, 0x00
};

const PROGMEM uint8_t good[32 * 32 / 8] = {
0x00, 0x00, 0x00, 0x80, 0xC0, 0xE0, 0xF0, 0xF8, 0xF8, 0xFC, 0xFC, 0xFE, 0xFE, 0xFE, 0xFE, 0xFE,
0xFE, 0xFE, 0xFE, 0xFE, 0xFE, 0xFC, 0xFC, 0xF8, 0xF8, 0xF0, 0xE0, 0xC0, 0x80, 0x00, 0x00, 0x00,
0x00, 0xF8, 0xFE, 0xFF, 0xFF, 0xFF, 0xFF, 0xF1, 0xE0, 0xC0, 0xC0, 0xC0, 0xE0, 0xF1, 0xFF, 0xFF,
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0x70, 0x70, 0x70, 0x78, 0x78, 0x3C, 0x3C, 0x1E, 0x1F, 0x0F, 0x07, 0x03, 0x01, 0x00, 0x00, 0x00
};

const PROGMEM uint8_t bad[32 * 32 / 8] = {
0x00, 0x00, 0x00, 0x80, 0xC0, 0xE0, 0xF0, 0xF8, 0xF8, 0xFC, 0xFC, 0xFE, 0xFE, 0xFE, 0xFE, 0xFE,
0xFE, 0xFE, 0xFE, 0xFE, 0xFE, 0xFC, 0xFC, 0xF8, 0xF8, 0xF0, 0xE0, 0xC0, 0x80, 0x00, 0x00, 0x00,
0x00, 0xF8, 0xFE, 0xFF, 0xFF, 0x0F, 0x0F, 0x07, 0x07, 0x07, 0x0F, 0x1F, 0xFF, 0xFF, 0xFF, 0xFF,
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0x7F, 0x7F, 0x7F, 0x78, 0x78, 0x38, 0x38, 0x1C, 0x1F, 0x0F, 0x07, 0x03, 0x01, 0x00, 0x00, 0x00
};

void setup() {
  // Configura os pinos como OUTPUT
  pinMode(pinAr, OUTPUT);
  pinMode(pinUmid, OUTPUT);

  // Inicializa o Sensor
  dht.begin();

  // Inicializa o Display e limpa a tela
  lcd.begin();
  lcd.clear();

  // Posiciona o Cursos e Imprime o Logo
  lcd.setCursor(39, 1);
  lcd.draw(logo, 48, 48);
  
  // Espera 5 segundos com o Logo na tela e limpa a tela
  delay(5000);
  lcd.clear();

  // Posiciona o Cursos e Imprime o Icone de Umidade Relativa
  lcd.setCursor(95, 0);
  lcd.draw(humidity, 32, 32);
}

void loop() {

  if (millis() - controleLeitura > INTERVALO_LEITURA) {
    float leitura = dht.readHumidity();

    lcd.setCursor(45, 1);

    if (!isnan(leitura)) {  // Confere se recebeu algum valor do sensor
      umidade = leitura;

      lcd.setFontSize(FONT_SIZE_XLARGE);
      lcd.print(umidade);
      lcd.setFontSize(FONT_SIZE_SMALL);

      controleLeitura = millis();
    } else {
      lcd.setCursor(0, 6);
      lcd.println(F("                  "));
      lcd.println(F("-->Falha no DHT<--"));
      delay(1000);
    }

    switch (estado) {
      case 0:                    // Leitura Anterior = Indicando Umidade ideal | Umidificador e Ar desligados
        if (umidade < UR_MIN) {  // Se Leitura Atual = Indicando Ar muito Seco
          estado = -1;
          digitalWrite(pinUmid, HIGH);

          lcd.setCursor(0, 0);
          lcd.draw(bad, 32, 32);
          
          lcd.setCursor(0, 6);
          lcd.println(F("Umidif.: Ligado   "));
          lcd.println(F("Ar-Cond: Desligado"));

        } else if (umidade > UR_MAX) {  // Se Leitura Atual = Indicando Ar muito umido
          estado = 1;
          digitalWrite(pinAr, HIGH);

          lcd.setCursor(0, 0);
          lcd.draw(bad, 32, 32);

          lcd.setCursor(0, 6);
          lcd.println(F("Umidif.: Desligado"));
          lcd.println(F("Ar-Cond: ligado   "));
        } 
        break;

      case -1:                      // Leitura Anterior = Indicando Umidade baixa | Umidificador ligado
        if (umidade >= UR_IDEAL) {  // Se Leitura Atual = Indicando Umidade subiu para o nível ideal
          estado = 0;
          digitalWrite(pinUmid, LOW);

          lcd.setCursor(0, 0);
          lcd.draw(good, 32, 32);

          lcd.setCursor(0, 6);
          lcd.println(F("Umidif.: Desligado"));
          lcd.println(F("Ar-Cond: Desligado"));
        }
        break;

      case 1:                       // Leitura Anterior = Indicando Umidade alta | Ar ligado
        if (umidade <= UR_IDEAL) {  // Se Leitura Atual = Indicando Umidade abaixou para o nível ideal
          estado = 0;
          digitalWrite(pinAr, LOW);

          lcd.setCursor(0, 0);
          lcd.draw(good, 32, 32);

          lcd.setCursor(0, 6);
          lcd.println(F("Umidif.: Desligado"));
          lcd.println(F("Ar-Cond: Desligado"));
        }
        break;
    }

  }
}
